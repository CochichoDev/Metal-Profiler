; Developed by Diogo Cochicho under Youcef Bouchebaba's supervision

PRIVATE &params &a53_x64 &a53_x64_234 &rwValue
ENTRY %LINE &params

&params=STRing.UPpeR("&params")
&a53_x64=STRing.SCAN("&params","A53_X64",0.)>=0.
&a53_x64_234=STRing.SCAN("&params","_A53_234_X64",0.)>=0.

PRIVATE &apuConfig0 &apuConfig1 &apuPwrctl &crfRstFdpApu
&apuConfig0=0xFD5C0020
&apuConfig1=0xFD5C0024
&apuPwrctl=0xFD5C0090
&crfRstFdpApu=0xFD1A0104
&csuJtagChainStatus=0xFFCA0034
&csuJtagSec=0xFFCA0038
&csuJtagDapCfg=0xFFCA003C
&rpuGlglCntl=0xFF9A0000
&rpu0Cfg=0xFF9A0100
&rpu1Cfg=0xFF9A0200
&crlRstLpdTop=0xFF5E023C

Data.Set ENAXI:0xFFFF0000 %Long 0xEA000000       // AArch64: "ands x0,x0,x0"; AArch32: "B $+0x8"
Data.Set ENAXI:0xFFFF0004 %Long 0x14000000       // Endless loop in OCM (64bit A64 Code)
Data.Set ENAXI:0xFFFF0008 %Long 0xEAFFFFFE       // Endless loop in OCM (32bit ARM code)

IF Data.Long(ENAXI:&csuJtagDapCfg)!=0x3f
(
  ; enable RPU/APU Secure/NonSecure debugging
  Data.Set ENAXI:&csuJtagSec %Long %LE 0x3F		
  Data.Set ENAXI:&csuJtagDapCfg %Long %LE 0x3f		// This is configured to NON-SECURED Boot Mode (the address for the JTAG_DAP_CFG was not found in the docs)
)


IF &a53_x64
(
	; ensure core is in reset
	// Data.Set ENAXI:&crfRstFdpApu %Long %LE Data.Long(ENAXI:&crfRstFdpApu)|(0x401)

	; ensure all cores are in reset
	Data.Set ENAXI:&crfRstFdpApu %Long %LE Data.Long(ENAXI:&crfRstFdpApu)|(0x3C0F)

	; set AARCH64 mode, Exception Vectors HIGH
	&rwValue=Data.Long(ENAXI:&apuConfig0)
	&rwValue=&rwValue&~((1.<<24.)|(1.<<16.)|(1.<<8.)|(1.<<0.))
	&rwValue=&rwValue|((1.<<8.)|(1.<<0.))
	Data.Set ENAXI:&apuConfig0 %Long %LE &rwValue

	; release core0 from reset
	Data.Set ENAXI:&crfRstFdpApu %Long %LE Data.Long(ENAXI:&crfRstFdpApu)&~(0x501)
)
IF &a53_x64_234
(
  ; ensure cores are in reset
  Data.Set ENAXI:&crfRstFdpApu %Long %LE Data.Long(ENAXI:&crfRstFdpApu)|(0x380E)

  ; set AARCH64 mode, Exception Vectors HIGH
  &rwValue=Data.Long(ENAXI:&apuConfig0)
  &rwValue=&rwValue&~((0xE<<24.)|(0xE<<16.)|(0xE<<8.)|(0xE<<0.))
  &rwValue=&rwValue|((0xE<<8.)|(0xE<<0.))
  Data.Set ENAXI:&apuConfig0 %Long %LE &rwValue

  ; release core&l2 from reset
  Data.Set ENAXI:&crfRstFdpApu %Long %LE Data.Long(ENAXI:&crfRstFdpApu)&~(0x380E)
)

ENDDO
