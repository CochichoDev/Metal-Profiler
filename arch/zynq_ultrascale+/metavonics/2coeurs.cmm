; Developed by Diogo Cochicho 
LOCAL       &core0 &core1 &core2 &core3
PARAMETERS  &core0 &core1 &core2 &core3 

; clear & powercycle
WinCLEAR
;DO "&scripts/PowerCycle.cmm"

&ppd=OS.PPD()

; --------------------------------------------------------------------------------
; check prerequisites
IF VERSION.BUILD.BASE()<75524.
(
  PRINT %ERROR "Please use more recent Software! Contact support@lauterbach.com."
  ENDDO
)

; --------------------------------------------------------------------------------
; initialize and start the debugger
RESet
SYStem.RESet

SYStem.CPU ZYNQ-ULTRASCALE+-APU
SYStem.Option TRST OFF
SYStem.Option ResBreak OFF
SYStem.Option WaitReset 500ms
SYStem.JtagClock CTCK 10MHz
; disable Trace infrastructure for the moment - TPIU may be unclocked!
SYStem.Mode Prepare

SYStem.Option TRST OFF
SYStem.Option ResBreak OFF
SYStem.Option WaitReset 500ms
SYStem.JtagClock CTCK 10MHz

DO "&ppd/zynq_ultrascale_kickboot.cmm" A53_X64
DO "&ppd/zynq_ultrascale_kickboot.cmm" _A53_234_X64

SYStem.Mode.Attach
IF STATE.RUN()
  Break.direct

; --------------------------------------------------------------------------------
; load the FSBL (first-stage boot loader) into the OCM
CORE.select 0
Data.LOAD.Elf "&ppd/Meta/zynqmp_fsbl/fsbl_a53.elf"

; --------------------------------------------------------------------------------
; start FSBL execution
CORE.select 0
Go.direct XFsbl_Loop
CORE.select 0
WAIT !STATE.RUN() 3.s

CORE.select 0
IF Register(PC)!=ADDRESS.OFFSET(XFsbl_Loop)
(
  PRINT %ERROR "Boot flow error"
  ENDDO
)


; --------------------------------------------------------------------------------
Break
IF "&core3"=="TRUE"
(
CORE.select 3
CACHE.INVALIDATE IC
CORE.select 3
CACHE.INVALIDATE DC
CORE.select 3
CACHE.INVALIDATE L2
CORE.select 3
Data.LOAD.Elf "&ppd/Core3/Debug/Core3.elf"
)
IF "&core2"=="TRUE"
(
CORE.select 2
CACHE.INVALIDATE IC
CORE.select 2
CACHE.INVALIDATE DC
CORE.select 2
CACHE.INVALIDATE L2
CORE.select 2
Data.LOAD.Elf "&ppd/Core2/Debug/Core2.elf"
)
IF "&core1"=="TRUE"
(
CORE.select 1
CACHE.INVALIDATE IC
CORE.select 1
CACHE.INVALIDATE DC
CORE.select 1
CACHE.INVALIDATE L2
CORE.select 1
Data.LOAD.Elf "&ppd/Core1/Debug/Core1.elf"
)
IF "&core0"=="TRUE"
(
CORE.select 0
CACHE.INVALIDATE IC
CORE.select 0
CACHE.INVALIDATE DC
CORE.select 0
CACHE.INVALIDATE L2
CORE.select 0
Data.LOAD.Elf "&ppd/Core0/Debug/Core0.elf"
)
Go
