; Developed by Diogo Cochicho 
LOCAL       &core0 &core1 &core2 &core3
PARAMETERS  &core0 &core1 &core2 &core3 

; clear & powercycle
WinCLEAR
;DO "&scripts/PowerCycle.cmm"

&ppd=OS.PPD()

; --------------------------------------------------------------------------------
; check prerequisites
IF VERSION.BUILD.BASE()<75524.
(
  PRINT %ERROR "Please use more recent Software! Contact support@lauterbach.com."
  ENDDO
)

; --------------------------------------------------------------------------------
; initialize and start the debugger
RESet
SYStem.RESet

SYStem.CPU ZYNQ-ULTRASCALE+-APU
SYStem.Option TRST OFF
SYStem.Option ResBreak OFF
SYStem.Option WaitReset 500ms
SYStem.JtagClock CTCK 10MHz
CORE.ASSIGN 1.
; disable Trace infrastructure for the moment - TPIU may be unclocked!
ETM.OFF
STM.OFF
Trace.DISable
SYStem.Mode Prepare

SYStem.Option TRST OFF
SYStem.Option ResBreak OFF
SYStem.Option WaitReset 500ms
SYStem.JtagClock CTCK 10MHz

DO "&ppd/zynq_ultrascale_kickboot.cmm" A53_X64

IF "&core1"=="TRUE"||"&core2"=="TRUE"||"&core3"=="TRUE"
(
DO "&ppd/zynq_ultrascale_kickboot.cmm" _A53_234_X64
)

SYStem.Mode.Attach
IF STATE.RUN()
  Break.direct

; --------------------------------------------------------------------------------
; load the FSBL (first-stage boot loader) into the OCM
CORE.select 0
Data.LOAD.Elf "&ppd/fsbl/bin/fsbl_a53.elf"
CORE.select 0
Break.Set ADDRESS.OFFSET(XFsbl_Loop)

; --------------------------------------------------------------------------------
; start FSBL execution
CORE.select 0
Go
CORE.select 0
WAIT STATE.RUN()
CORE.select 0
WAIT !STATE.RUN()

CORE.select 0
IF Register(PC)!=ADDRESS.OFFSET(XFsbl_Loop)
(
  PRINT %ERROR "Boot flow error"
  ENDDO
)

CORE.select 0 
Data.LOAD.Elf "&ppd/LOADER/bin/LOADER.elf"

; --------------------------------------------------------------------------------
Intercom.name A53_0
IF "&core3"=="TRUE"
(
TargetSystem.NewInstance A53_3
InterCom A53_3 SYStem.CPU ZYNQ-ULTRASCALE+-APU
InterCom A53_3 SYStem.Option TRST OFF
InterCom A53_3 SYStem.Option ResBreak OFF
InterCom A53_3 SYStem.Option WaitReset 500ms
InterCom A53_3 SYStem.JtagClock CTCK 10MHz
InterCom A53_3 SYStem.CONFIG Core 4. 1.
InterCom A53_3 CORE.ASSIGN 4.

InterCom A53_3 ETM.OFF
InterCom A53_3 STM.OFF
InterCom A53_3 Trace.DISable

InterCom A53_3 SYStem.Mode.Attach

InterCom A53_3 Break
InterCom A53_3 Data.LOAD.Elf "&ppd/Core4/bin/Core4.elf"
InterCom A53_3 Go
InterCom A53_3 QUIT
)
IF "&core2"=="TRUE"
(
TargetSystem.NewInstance A53_2
InterCom A53_2 SYStem.CPU ZYNQ-ULTRASCALE+-APU
InterCom A53_2 SYStem.Option TRST OFF
InterCom A53_2 SYStem.Option ResBreak OFF
InterCom A53_2 SYStem.Option WaitReset 500ms
InterCom A53_2 SYStem.JtagClock CTCK 10MHz
InterCom A53_2 SYStem.CONFIG Core 3. 1.
InterCom A53_2 CORE.ASSIGN 3.

InterCom A53_2 ETM.OFF
InterCom A53_2 STM.OFF
InterCom A53_2 Trace.DISable

InterCom A53_2 SYStem.Mode.Attach

InterCom A53_2 Break
InterCom A53_2 Data.LOAD.Elf "&ppd/Core3/bin/Core3.elf"
InterCom A53_2 Go
InterCom A53_2 QUIT
)
IF "&core1"=="TRUE"
(
TargetSystem.NewInstance A53_1
InterCom A53_1 SYStem.CPU ZYNQ-ULTRASCALE+-APU
InterCom A53_1 SYStem.Option TRST OFF
InterCom A53_1 SYStem.Option ResBreak OFF
InterCom A53_1 SYStem.Option WaitReset 500ms
InterCom A53_1 SYStem.JtagClock CTCK 10MHz
InterCom A53_1 SYStem.CONFIG Core 2. 1.
InterCom A53_1 CORE.ASSIGN 2.

InterCom A53_1 ETM.OFF
InterCom A53_1 STM.OFF
InterCom A53_1 Trace.DISable

InterCom A53_1 SYStem.Mode.Attach

InterCom A53_1 Break
InterCom A53_1 Data.LOAD.Elf "&ppd/Core2/bin/Core2.elf"
InterCom A53_1 Go
InterCom A53_1 QUIT
)
IF "&core0"=="TRUE"
(
InterCom A53_0 SYStem.CONFIG Core 1. 1.
InterCom A53_0 CACHE.INVALIDATE IC
InterCom A53_0 CACHE.INVALIDATE DC
InterCom A53_0 CACHE.INVALIDATE L2
InterCom A53_0 Break
InterCom A53_0 Data.LOAD.Elf "&ppd/Core1/bin/Core1.elf"
InterCom A53_0 Go
)
